#include <stdint.h>
#include <stdbool.h>
#include <stdlib.h>
#include "freertos/FreeRTOS.h"
#include "freertos/task.h"
#include "driver/gpio.h"
#include "driver/spi_master.h"
#include "esp_check.h"
#include "esp_heap_caps.h"
#include "esp_log.h"
#include "esp_rom_sys.h"
#include "car_display.h"

/* 接线与v20_line_car_vscode.ino保持一致。 */
#define TFT_CS_PIN 8
#define TFT_SCK_PIN 9
#define TFT_MOSI_PIN 1
#define TFT_DC_PIN 2
#define TFT_RST_PIN 3
#define TFT_WIDTH 160
#define TFT_HEIGHT 128
#define DISPLAY_POLL_MS 20
#define DISPLAY_MIN_REFRESH_MS 250
#define DISPLAY_FORCE_REFRESH_MS 2000
#define DISPLAY_PWM_CHANGE 3
#define NEW_LINE_HOLD_MS 700

#define RGB565(r, g, b) (uint16_t)((((r) & 0xF8) << 8) | (((g) & 0xFC) << 3) | ((b) >> 3))
#define COLOR_BLACK RGB565(0, 0, 0)
#define COLOR_WHITE RGB565(255, 255, 255)
#define COLOR_CYAN RGB565(0, 220, 255)
#define COLOR_GREEN RGB565(0, 255, 80)
#define COLOR_YELLOW RGB565(255, 210, 0)
#define COLOR_RED RGB565(255, 40, 40)

static const char *TAG = "car_display";
static spi_device_handle_t s_lcd;
static uint16_t *s_framebuffer;
static volatile int s_left_pwm;
static volatile int s_back_pwm;
static volatile int s_right_pwm;
static volatile car_display_state_t s_state = CAR_DISPLAY_STOP;
static volatile TickType_t s_new_line_tick;
static esp_err_t s_spi_error = ESP_OK;

/* 24x24中文点阵，依次为“直、行、停、车、左、右、转、识、别、丢、线、开、始、新”。 */
static const uint8_t s_hanzi[][72] = {
    {0x00,0x00,0x00,0x00,0x38,0x00,0x3F,0xFF,0xFC,0x3F,0xFF,0xFC,0x00,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0x00,0x00},
    {0x00,0x00,0x00,0x02,0x00,0x00,0x07,0x80,0x00,0x0F,0x9F,0xFC,0x1F,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0x00,0x00},
    {0x00,0x00,0x00,0x06,0x07,0x00,0x06,0x07,0x00,0x0F,0xFF,0xFE,0x0F,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0x00,0x00},
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    {0x07,0x00,0x0C,0x03,0x80,0x7C,0x3F,0xF7,0xFC,0x3F,0xF7,0xF0,0x08,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0x00,0x00},
};

/* 向ST7735发送一条命令。 */
static void lcd_command(uint8_t command)
{
    if (s_spi_error != ESP_OK) return;
    gpio_set_level(TFT_DC_PIN, 0);
    spi_transaction_t transaction = {.length = 8, .tx_buffer = &command};
    s_spi_error = spi_device_polling_transmit(s_lcd, &transaction);
}

/* 向ST7735发送命令参数。 */
static void lcd_data(const void *data, size_t length)
{
    if (length == 0 || s_spi_error != ESP_OK) return;
    gpio_set_level(TFT_DC_PIN, 1);
    spi_transaction_t transaction = {.length = length * 8, .tx_buffer = data};
    s_spi_error = spi_device_polling_transmit(s_lcd, &transaction);
}

/* 发送带参数的ST7735初始化命令。 */
static void lcd_command_data(uint8_t command, const uint8_t *data, size_t length)
{
    lcd_command(command);
    lcd_data(data, length);
}

/* 初始化与Arduino版INITR_BLACKTAB等效的ST7735横屏模式。 */
static void lcd_panel_init(void)
{
    gpio_set_level(TFT_RST_PIN, 0);
    esp_rom_delay_us(20000);
    gpio_set_level(TFT_RST_PIN, 1);
    vTaskDelay(pdMS_TO_TICKS(150));

    lcd_command(0x01);
    vTaskDelay(pdMS_TO_TICKS(150));
    lcd_command(0x11);
    vTaskDelay(pdMS_TO_TICKS(500));
    const uint8_t frame_rate[] = {0x01, 0x2C, 0x2D};
    const uint8_t frame_rate3[] = {0x01, 0x2C, 0x2D, 0x01, 0x2C, 0x2D};
    const uint8_t power1[] = {0xA2, 0x02, 0x84};
    const uint8_t power3[] = {0x0A, 0x00};
    const uint8_t power4[] = {0x8A, 0x2A};
    const uint8_t power5[] = {0x8A, 0xEE};
    lcd_command_data(0xB1, frame_rate, sizeof(frame_rate));
    lcd_command_data(0xB2, frame_rate, sizeof(frame_rate));
    lcd_command_data(0xB3, frame_rate3, sizeof(frame_rate3));
    const uint8_t inversion = 0x07;
    lcd_command_data(0xB4, &inversion, 1);
    lcd_command_data(0xC0, power1, sizeof(power1));
    const uint8_t power2 = 0xC5;
    lcd_command_data(0xC1, &power2, 1);
    lcd_command_data(0xC2, power3, sizeof(power3));
    lcd_command_data(0xC3, power4, sizeof(power4));
    lcd_command_data(0xC4, power5, sizeof(power5));
    const uint8_t vcom = 0x0E;
    lcd_command_data(0xC5, &vcom, 1);
    const uint8_t color_mode = 0x05;
    const uint8_t portrait_direction = 0xC8;
    const uint8_t portrait_columns[] = {0x00, 0x00, 0x00, 0x7F};
    const uint8_t portrait_rows[] = {0x00, 0x00, 0x00, 0x9F};
    lcd_command_data(0x36, &portrait_direction, 1);
    lcd_command_data(0x3A, &color_mode, 1);
    lcd_command_data(0x2A, portrait_columns, sizeof(portrait_columns));
    lcd_command_data(0x2B, portrait_rows, sizeof(portrait_rows));
    const uint8_t gamma_positive[] = {
        0x02,0x1C,0x07,0x12,0x37,0x32,0x29,0x2D,
        0x29,0x25,0x2B,0x39,0x00,0x01,0x03,0x10,
    };
    const uint8_t gamma_negative[] = {
        0x03,0x1D,0x07,0x06,0x2E,0x2C,0x29,0x2D,
        0x2E,0x2E,0x37,0x3F,0x00,0x00,0x02,0x10,
    };
    lcd_command_data(0xE0, gamma_positive, sizeof(gamma_positive));
    lcd_command_data(0xE1, gamma_negative, sizeof(gamma_negative));

    /* INITR_BLACKTAB在公共初始化后切换为RGB颜色顺序。 */
    const uint8_t black_tab_direction = 0xC0;
    lcd_command_data(0x36, &black_tab_direction, 1);
    lcd_command(0x13);
    vTaskDelay(pdMS_TO_TICKS(10));
    lcd_command(0x29);
    vTaskDelay(pdMS_TO_TICKS(100));

    /* 与Adafruit setRotation(1)完全相同：MY | MV | RGB。 */
    /* 按小车上显示屏的实际安装方向，将横屏画面旋转 180 度。 */
    const uint8_t landscape_direction = 0xA0;
    lcd_command_data(0x36, &landscape_direction, 1);
}

/* 将RGB565颜色转换成屏幕SPI传输所需的高字节在前格式。 */
static uint16_t lcd_color(uint16_t color)
{
    return (uint16_t)((color << 8) | (color >> 8));
}

/* 在内存画布中填充矩形。 */
static void fill_rect(int x, int y, int width, int height, uint16_t color)
{
    if (x < 0 || y < 0 || x + width > TFT_WIDTH || y + height > TFT_HEIGHT) return;
    uint16_t output_color = lcd_color(color);
    for (int row = y; row < y + height; row++) {
        for (int column = x; column < x + width; column++) {
            s_framebuffer[row * TFT_WIDTH + column] = output_color;
        }
    }
}

/* 绘制一个24x24中文点阵字。 */
static void draw_hanzi(int x, int y, int index, uint16_t color)
{
    for (int row = 0; row < 24; row++) {
        for (int column = 0; column < 24; column++) {
            uint8_t byte = s_hanzi[index][row * 3 + column / 8];
            if (byte & (0x80 >> (column & 7))) fill_rect(x + column, y + row, 1, 1, color);
        }
    }
}

/* 用放大的线段绘制一个数字。 */
static void draw_digit(int x, int y, int digit, uint16_t color)
{
    static const uint8_t segments[10] = {
        0x3F, 0x06, 0x5B, 0x4F, 0x66, 0x6D, 0x7D, 0x07, 0x7F, 0x6F,
    };
    uint8_t mask = segments[digit];
    if (mask & 0x01) fill_rect(x + 3, y, 8, 3, color);
    if (mask & 0x02) fill_rect(x + 11, y + 3, 3, 7, color);
    if (mask & 0x04) fill_rect(x + 11, y + 12, 3, 7, color);
    if (mask & 0x08) fill_rect(x + 3, y + 19, 8, 3, color);
    if (mask & 0x10) fill_rect(x, y + 12, 3, 7, color);
    if (mask & 0x20) fill_rect(x, y + 3, 3, 7, color);
    if (mask & 0x40) fill_rect(x + 3, y + 9, 8, 3, color);
}

/* 绘制A、B、D轮名称。 */
static void draw_wheel_letter(int x, int y, char letter, uint16_t color)
{
    if (letter == 'A') {
        fill_rect(x, y + 5, 3, 17, color); fill_rect(x + 12, y + 5, 3, 17, color);
        fill_rect(x + 3, y + 2, 9, 3, color); fill_rect(x + 3, y + 11, 9, 3, color);
    } else if (letter == 'B') {
        fill_rect(x, y + 2, 3, 20, color); fill_rect(x + 3, y + 2, 8, 3, color);
        fill_rect(x + 3, y + 10, 8, 3, color); fill_rect(x + 3, y + 19, 8, 3, color);
        fill_rect(x + 11, y + 5, 3, 5, color); fill_rect(x + 11, y + 13, 3, 6, color);
    } else {
        fill_rect(x, y + 2, 3, 20, color); fill_rect(x + 3, y + 2, 7, 3, color);
        fill_rect(x + 3, y + 19, 7, 3, color); fill_rect(x + 10, y + 5, 3, 14, color);
    }
}

/* 绘制一个轮子的名称、方向符号和三位PWM。 */
static void draw_wheel_row(int y, char wheel, int pwm, uint16_t color)
{
    draw_wheel_letter(8, y, wheel, color);
    if (pwm < 0) fill_rect(31, y + 10, 12, 3, COLOR_RED);
    else fill_rect(35, y + 5, 3, 13, pwm > 0 ? color : COLOR_WHITE);
    if (pwm > 0) fill_rect(31, y + 10, 11, 3, color);
    int value = abs(pwm);
    draw_digit(53, y, (value / 100) % 10, color);
    draw_digit(72, y, (value / 10) % 10, color);
    draw_digit(91, y, value % 10, color);
}

/* 在顶部居中绘制二到四个大号中文状态字。 */
static void draw_state_word(const uint8_t *characters, int count, uint16_t color)
{
    int total_width = count * 24 + (count - 1) * 4;
    int x = (TFT_WIDTH - total_width) / 2;
    for (int index = 0; index < count; index++) {
        draw_hanzi(x + index * 28, 2, characters[index], color);
    }
}

/* 绘制顶部的大号中文运动判别。 */
static void draw_state(car_display_state_t state)
{
    static const uint8_t straight[] = {0, 1};
    static const uint8_t detected_left[] = {7, 8, 4, 6};
    static const uint8_t detected_right[] = {7, 8, 5, 6};
    static const uint8_t lost_forward[] = {9, 10, 0, 1};
    static const uint8_t turning_left[] = {11, 12, 4, 6};
    static const uint8_t turning_right[] = {11, 12, 5, 6};
    static const uint8_t new_line[] = {7, 8, 13, 10};
    /* 使用现有大字字模显示“开始左行”，表示避障左横移已经启动。 */
    static const uint8_t move_left[] = {11, 12, 4, 1};
    static const uint8_t stop[] = {2, 3};

    switch (state) {
    case CAR_DISPLAY_DETECTED_LEFT:
        draw_state_word(detected_left, 4, COLOR_YELLOW); break;
    case CAR_DISPLAY_DETECTED_RIGHT:
        draw_state_word(detected_right, 4, COLOR_YELLOW); break;
    case CAR_DISPLAY_LOST_FORWARD:
        draw_state_word(lost_forward, 4, COLOR_YELLOW); break;
    case CAR_DISPLAY_TURNING_LEFT:
        draw_state_word(turning_left, 4, COLOR_CYAN); break;
    case CAR_DISPLAY_TURNING_RIGHT:
        draw_state_word(turning_right, 4, COLOR_CYAN); break;
    case CAR_DISPLAY_NEW_LINE:
        draw_state_word(new_line, 4, COLOR_GREEN); break;
    case CAR_DISPLAY_MOVE_LEFT:
        draw_state_word(move_left, 4, COLOR_YELLOW); break;
    case CAR_DISPLAY_STOP:
        draw_state_word(stop, 2, COLOR_RED); break;
    default:
        draw_state_word(straight, 2, COLOR_GREEN); break;
    }
}

/* 把完整160x128画面传输到ST7735。 */
static void lcd_present(void)
{
    const uint8_t columns[] = {0x00, 0x00, 0x00, TFT_WIDTH - 1};
    const uint8_t rows[] = {0x00, 0x00, 0x00, TFT_HEIGHT - 1};
    lcd_command_data(0x2A, columns, sizeof(columns));
    lcd_command_data(0x2B, rows, sizeof(rows));
    lcd_command(0x2C);
    /* Adafruit库会分批写入像素；这里也逐行发送，避免一次超长SPI事务花屏。 */
    for (int row = 0; row < TFT_HEIGHT; row++) {
        lcd_data(s_framebuffer + row * TFT_WIDTH,
                 TFT_WIDTH * sizeof(uint16_t));
    }
}

/* 低优先级独立刷新屏幕，避免阻塞摄像头巡线状态机。 */
static void display_task(void *argument)
{
    (void)argument;
    int drawn_left_pwm = 0;
    int drawn_back_pwm = 0;
    int drawn_right_pwm = 0;
    car_display_state_t drawn_state = CAR_DISPLAY_STOP;
    TickType_t last_refresh = 0;
    bool first_refresh = true;

    while (true) {
        int left_pwm = s_left_pwm;
        int back_pwm = s_back_pwm;
        int right_pwm = s_right_pwm;
        car_display_state_t state = s_state;
        TickType_t now = xTaskGetTickCount();
        bool changed = state != drawn_state ||
                       abs(left_pwm - drawn_left_pwm) >= DISPLAY_PWM_CHANGE ||
                       abs(back_pwm - drawn_back_pwm) >= DISPLAY_PWM_CHANGE ||
                       abs(right_pwm - drawn_right_pwm) >= DISPLAY_PWM_CHANGE;
        bool minimum_interval_reached =
            now - last_refresh >= pdMS_TO_TICKS(DISPLAY_MIN_REFRESH_MS);
        bool force_refresh =
            now - last_refresh >= pdMS_TO_TICKS(DISPLAY_FORCE_REFRESH_MS);

        if (first_refresh || (changed && minimum_interval_reached) || force_refresh) {
        fill_rect(0, 0, TFT_WIDTH, TFT_HEIGHT, COLOR_BLACK);
        draw_state(state);
        fill_rect(0, 31, TFT_WIDTH, 2, RGB565(40, 80, 150));
        draw_wheel_row(37, 'A', left_pwm, COLOR_CYAN);
        draw_wheel_row(68, 'B', back_pwm, COLOR_YELLOW);
        draw_wheel_row(99, 'D', right_pwm, COLOR_GREEN);
        lcd_present();
        if (s_spi_error != ESP_OK) {
            ESP_LOGE(TAG, "屏幕SPI传输失败，停止显示任务但保持巡线运行：%s",
                     esp_err_to_name(s_spi_error));
            vTaskDelete(NULL);
            return;
        }
            drawn_left_pwm = left_pwm;
            drawn_back_pwm = back_pwm;
            drawn_right_pwm = right_pwm;
            drawn_state = state;
            last_refresh = now;
            first_refresh = false;
        }
        vTaskDelay(pdMS_TO_TICKS(DISPLAY_POLL_MS));
    }
}

void car_display_set(int left_pwm, int back_pwm, int right_pwm,
                     car_display_state_t state)
{
    s_left_pwm = left_pwm;
    s_back_pwm = back_pwm;
    s_right_pwm = right_pwm;
    TickType_t now = xTaskGetTickCount();
    if (state == CAR_DISPLAY_NEW_LINE) s_new_line_tick = now;
    if (s_state == CAR_DISPLAY_NEW_LINE && state == CAR_DISPLAY_STRAIGHT &&
        now - s_new_line_tick < pdMS_TO_TICKS(NEW_LINE_HOLD_MS)) return;
    s_state = state;
}

esp_err_t car_display_init(void)
{
    s_spi_error = ESP_OK;
    gpio_config_t output = {
        .pin_bit_mask = (1ULL << TFT_DC_PIN) | (1ULL << TFT_RST_PIN),
        .mode = GPIO_MODE_OUTPUT,
    };
    esp_err_t error = gpio_config(&output);
    if (error != ESP_OK) return error;
    spi_bus_config_t bus = {
        .mosi_io_num = TFT_MOSI_PIN,
        .miso_io_num = -1,
        .sclk_io_num = TFT_SCK_PIN,
        .quadwp_io_num = -1,
        .quadhd_io_num = -1,
        .max_transfer_sz = TFT_WIDTH * TFT_HEIGHT * sizeof(uint16_t),
    };
    error = spi_bus_initialize(SPI2_HOST, &bus, SPI_DMA_CH_AUTO);
    if (error != ESP_OK) return error;
    spi_device_interface_config_t device = {
        /* 降低SPI时钟以提高杜邦线连接时的信号稳定性。 */
        .clock_speed_hz = 8 * 1000 * 1000,
        .mode = 0,
        .spics_io_num = TFT_CS_PIN,
        .queue_size = 1,
    };
    error = spi_bus_add_device(SPI2_HOST, &device, &s_lcd);
    if (error != ESP_OK) {
        spi_bus_free(SPI2_HOST);
        return error;
    }
    s_framebuffer = heap_caps_malloc(TFT_WIDTH * TFT_HEIGHT * sizeof(uint16_t),
                                     MALLOC_CAP_DMA | MALLOC_CAP_INTERNAL);
    if (!s_framebuffer) {
        spi_bus_remove_device(s_lcd);
        spi_bus_free(SPI2_HOST);
        return ESP_ERR_NO_MEM;
    }
    lcd_panel_init();
    if (s_spi_error != ESP_OK) {
        error = s_spi_error;
        heap_caps_free(s_framebuffer);
        s_framebuffer = NULL;
        spi_bus_remove_device(s_lcd);
        spi_bus_free(SPI2_HOST);
        return error;
    }
    BaseType_t created = xTaskCreatePinnedToCore(display_task, "display", 4096,
                                                 NULL, 1, NULL, 0);
    if (created != pdPASS) {
        heap_caps_free(s_framebuffer);
        s_framebuffer = NULL;
        spi_bus_remove_device(s_lcd);
        spi_bus_free(SPI2_HOST);
        return ESP_FAIL;
    }
    ESP_LOGI(TAG, "ST7735 ready: CS=%d SCK=%d MOSI=%d DC=%d RST=%d",
             TFT_CS_PIN, TFT_SCK_PIN, TFT_MOSI_PIN, TFT_DC_PIN, TFT_RST_PIN);
    return ESP_OK;
}
